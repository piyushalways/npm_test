## build/Kconfig/boards/Kconfig.defconfig
```kconfig
# Load Zephyr board defconfig descriptions.
osource "C:/ncs/v3.0.1/zephyr/boards/nordic/nrf54l15dk/Kconfig.defconfig"
```

## build/npm1300_fuel_gauge-Copy/Kconfig/Kconfig.shield
```kconfig
osource "C:/Users/Lenovo/INRGZ/npm1300_fuel_gauge-Copy/boards/shields/*/Kconfig.shield"
osource "C:/ncs/v3.0.1/nrf/boards/shields/*/Kconfig.shield"
```
